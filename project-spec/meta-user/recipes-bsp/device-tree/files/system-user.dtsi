/include/ "system-conf.dtsi"
/ {
chosen {
bootargs = "console=ttyPS0,115200 earlyprintk cpuidle.off=1 root=/dev/mmcblk0p2 rw rootwait";
	};
};
&sdhci0 {
        status = "okay";
        max-frequency = <50000000>;
        disable-wp;
        /*no-1-8-v;*/ 
}; 
